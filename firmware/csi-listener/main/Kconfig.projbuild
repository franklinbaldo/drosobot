## firmware/csi-listener/main/Kconfig.projbuild
```kconfig
menu "DrosoBot CSI independent receive-only lab"
    config DROSOBOT_CSI_CHANNEL
        int "Fixed 2.4 GHz listening channel (match access point manually)"
        range 1 11
        default 1
        help
            Dedicated standalone ESP32-C3 only. No channel hopping, no association,
            no router configuration, no frame transmission. Pick actual AP channel.
    config DROSOBOT_CSI_MAX_WINDOWS
        int "Number of 1-second aggregate windows before radio stops"
        range 10 1200
        default 600
        help
            Hard stop after 10 minutes by default. Power cycle for another run.
endmenu
```

## firmware/csi-listener/sdkconfig.defaults
```kconfig
CONFIG_IDF_TARGET="esp32c3"
CONFIG_ESP_WIFI_CSI_ENABLED=y
CONFIG_LOG_DEFAULT_LEVEL_WARN=y
CONFIG_ESP_MAIN_TASK_STACK_SIZE=6144
```

## firmware/csi-observer/main/Kconfig.projbuild
```kconfig
menu "DrosoBot CSI observer on SEPARATE test ESP32-C3 ONLY"
    config DROSOBOT_CSI_SSID
        string "Wi-Fi SSID of authorized Tenda LAN (keep sdkconfig private)"
        default "DROSOBOT_UNCONFIGURED"
    config DROSOBOT_CSI_PASSWORD
        string "Wi-Fi password (NEVER commit sdkconfig)"
        default ""
    config DROSOBOT_CSI_PING_INTERVAL_MS
        int "ICMP interval for known associated Wi-Fi gateway in ms"
        range 1000 5000
        default 1000
    config DROSOBOT_CSI_MAX_WINDOWS
        int "Number of one-second feature windows, then stop radio"
        range 10 600
        default 600
endmenu
```

## firmware/csi-observer/sdkconfig.defaults
```kconfig
CONFIG_IDF_TARGET="esp32c3"
CONFIG_ESP_WIFI_CSI_ENABLED=y
CONFIG_DROSOBOT_CSI_SSID="DROSOBOT_UNCONFIGURED"
CONFIG_DROSOBOT_CSI_PASSWORD=""
CONFIG_DROSOBOT_CSI_PING_INTERVAL_MS=1000
CONFIG_DROSOBOT_CSI_MAX_WINDOWS=600
```
